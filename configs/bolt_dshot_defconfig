## src/hal/src/Kconfig
```kconfig
menu "Power management configuration"

config PM_AUTO_SHUTDOWN
    bool "Enable automatic shutdown"
    default n
    help
        The power management subsystem can automatically shutdown the system.
        The shutdown time in minutes is defined in platform_defaults_* for
        the specific platform and is the time since the last radio communication
        occurred.

endmenu

menu "Communication"

config SYSLINK_RX_DMA
    bool "Use DMA to receive uart syslink data instead of interrupts"
    default n
    help
        Using DMA to receive uart data reduces CPU load and will free
        up recources for other things. DMA is a shared resource though
        and might conflict with other functionality in the future.

config ENABLE_CPX
  bool "Enable CPX"
  select ENABLE_CPX_ON_UART2
  default y
  help
      This enables CPX routers and API

config ENABLE_CPX_ON_UART2
  bool "Enable CPX on UART2"
  depends on ENABLE_CPX
  default y
  help
      This enables CPX routing on UART2

config CPX_UART2_BAUDRATE
  int "CPX UART2 baudrate"
  depends on ENABLE_CPX_ON_UART2
  range 9600 2000000
  default 576000
  help
      Set the baudrate that will be used for CPX on UART2

endmenu

menu "IMU UART stream"

config IMU_UART_STREAM
    bool "Stream the IMU at 1 kHz on UART2 with PPS and GPRMC time sync"
    depends on SENSORS_BMI088_BMP3XX
    depends on !DEBUG_PRINT_ON_UART1
    depends on !MOTORS_ESC_PROTOCOL_DSHOT
    default n
    help
        Sends every IMU sample, before low pass filtering, as a binary frame
        on TX2 (PA2) at 1 Mbaud. Also outputs a hardware timed pulse per
        second on RX2 (PA3) and a matching GPRMC sentence on TX1 (PC10) at
        9600 baud, which a Livox lidar can use to lock its clock to the time
        base of the IMU timestamps.

        Takes over UART1, UART2, TIM5 and DMA1 stream 6, so it can not be
        combined with decks or features that use them (AI deck, CPX on
        UART2, debug print on UART1, DShot).

endmenu
```
