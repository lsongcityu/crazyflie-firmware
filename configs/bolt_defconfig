## configs/bolt_defconfig
```kconfig
CONFIG_PLATFORM_BOLT=y

CONFIG_ESTIMATOR_AUTO_SELECT=y
CONFIG_CONTROLLER_AUTO_SELECT=y

CONFIG_DECK_FORCE="bcMG902"
CONFIG_DECK_MG902=y

CONFIG_MOTORS_ESC_PROTOCOL_DSHOT=y
```

## configs/cf2_defconfig
```kconfig
CONFIG_PLATFORM_CF2=y

CONFIG_DECK_SERVO=y

CONFIG_DECK_SERVO_USE_IO2=y

CONFIG_DECK_INA228=y
CONFIG_DECK_FORCE="bcServo:bcINA228"
```
